## megamemsacc/west.yml
```yaml
manifest:
  version: "0.13"

  remotes:
    - name: zephyrproject
      url-base: https://github.com/zephyrproject-rtos

  projects:
    - name: zephyr
      remote: zephyrproject
      revision: v4.4.0
      import:
        name-allowlist:
          - cmsis
          - hal_stm32

  self:
    path: firmware          # ← name of your project directory
```
